## board/k1/muse_pi_pro/Kconfig
```kconfig
#
# SPDX-License-Identifier: Apache-2.0
#

config ARCH_BOARD_K1_MUSE_PI_PRO
	bool "MUSE Pi Pro (SpacemiT K1)"
	default y
	select ARCH_RV64
	select ARCH_RV_ISA_M
	select ARCH_RV_ISA_A
	select ARCH_RV_ISA_C
	select ARCH_HAVE_MULTICPU
	select ARCH_HAVE_S_MODE
	---help---
		Enable board support for the SpacemiT K1 based MUSE Pi Pro.
```

## board/k1/muse_pi_pro/configs/hardware_bringup/defconfig
```kconfig
# K1 combined hardware bring-up configuration.
#
# This image combines the already validated GPIO/PLIC, EMAC0, I2C2, SPI3,
# and watchdog paths. PWM11 is intentionally kept in its separate profile
# until a physical waveform measurement is available.

#include "../nsh/defconfig"

# GPIO / PLIC edge interrupt validation.
CONFIG_K1_PLIC=y
CONFIG_K1_GPIO_IRQ=y

# EMAC0 / RTL8211F polling validation.
CONFIG_NET=y
CONFIG_NET_ETHERNET=y
CONFIG_NETDEVICES=y
CONFIG_NET_ICMP=y
CONFIG_NET_ICMP_SOCKET=y
CONFIG_NET_UDP=y
CONFIG_NET_SOCKOPTS=y
CONFIG_K1_UDP_ECHO=y
CONFIG_K1_UDP_ECHO_PORT=33333
CONFIG_K1_UDP_ECHO_PACKETS=4
CONFIG_K1_UDP_ECHO_STACKSIZE=8192
CONFIG_K1_EMAC=y
CONFIG_K1_EMAC_DMA_POLL_MSEC=10
CONFIG_NETDEV_PHY_IOCTL=y
CONFIG_SYSTEM_MDIO=y
CONFIG_SYSTEM_PING=y
CONFIG_SYSTEM_PING_STACKSIZE=4096
CONFIG_DEBUG_NET_INFO=y
CONFIG_DEBUG_NET_WARN=y
CONFIG_NET_ETH_PKTSIZE=1514
CONFIG_IOB_NBUFFERS=16
CONFIG_IOB_BUFSIZE=1536
CONFIG_IOB_ALIGNMENT=64
CONFIG_LIBC_SEM_MUTEX_NOINLINE=y

# I2C2 board EEPROM validation.
CONFIG_I2C=y
CONFIG_I2C_DRIVER=y
CONFIG_I2C_RESET=y
CONFIG_SYSTEM_I2CTOOL=y
CONFIG_I2CTOOL_MINBUS=2
CONFIG_I2CTOOL_MAXBUS=2
CONFIG_I2CTOOL_MINADDR=0x50
CONFIG_I2CTOOL_MAXADDR=0x50
CONFIG_I2CTOOL_DEFFREQ=100000
CONFIG_K1_I2C=y
CONFIG_K1_I2C2=y
CONFIG_K1_I2C_POLL_TIMEOUT_USEC=100000

# SPI3 loopback validation.
CONFIG_SPI=y
CONFIG_SPI_DRIVER=y
CONFIG_SYSTEM_SPITOOL=y
CONFIG_SPITOOL_MINBUS=3
CONFIG_SPITOOL_MAXBUS=3
CONFIG_SPITOOL_DEFFREQ=800000
CONFIG_SPITOOL_DEFMODE=0
CONFIG_SPITOOL_DEFWIDTH=8
CONFIG_SPITOOL_DEFWORDS=4
CONFIG_SPITOOL_STACKSIZE=4096
CONFIG_K1_SPI=y
CONFIG_K1_SPI3=y
CONFIG_K1_SPI_POLL_TIMEOUT_USEC=100000

# Safe watchdog start/keepalive/stop smoke.
CONFIG_WATCHDOG=y
CONFIG_K1_WATCHDOG=y
CONFIG_K1_WATCHDOG_SMOKE=y
```

## board/k1/muse_pi_pro/configs/i2c/defconfig
```kconfig
# K1 I2C2 board EEPROM read-only verification configuration.

#include "../nsh/defconfig"

CONFIG_I2C=y
CONFIG_I2C_DRIVER=y
CONFIG_I2C_RESET=y
CONFIG_SYSTEM_I2CTOOL=y
CONFIG_NSH_MAXARGUMENTS=12
CONFIG_DEFAULT_TASK_STACKSIZE=4096
CONFIG_K1_I2C=y
CONFIG_K1_I2C2=y
CONFIG_K1_I2C_POLL_TIMEOUT_USEC=100000
CONFIG_I2CTOOL_MINBUS=2
CONFIG_I2CTOOL_MAXBUS=2
CONFIG_I2CTOOL_MINADDR=0x50
CONFIG_I2CTOOL_MAXADDR=0x50
CONFIG_I2CTOOL_DEFFREQ=100000
```

## board/k1/muse_pi_pro/configs/nsh/defconfig
```kconfig
#
# MUSE Pi Pro minimal NSH bring-up configuration.
#

CONFIG_ARCH="risc-v"
CONFIG_ARCH_RISCV=y
CONFIG_ARCH_RV64=y
CONFIG_ARCH_RV_ISA_M=y
CONFIG_ARCH_RV_ISA_A=y
CONFIG_ARCH_RV_ISA_C=y
CONFIG_ARCH_RV_ISA_ZICSR_ZIFENCEI=y
CONFIG_ARCH_HAVE_MULTICPU=y
CONFIG_ARCH_HAVE_S_MODE=y
CONFIG_ARCH_USE_S_MODE=y
CONFIG_ARCH_RV_EXT_SSTC=y
CONFIG_ARCH_CHIP_RISCV_CUSTOM=y
CONFIG_ARCH_CHIP_CUSTOM=y
CONFIG_ARCH_CHIP_CUSTOM_DIR="../vendor/spacemit/chips/k1"
CONFIG_ARCH_CHIP_CUSTOM_DIR_RELPATH=y
CONFIG_ARCH_CHIP_CUSTOM_NAME="k1"
CONFIG_ARCH_BOARD_CUSTOM=y
CONFIG_ARCH_BOARD_CUSTOM_DIR="../vendor/spacemit/boards/k1/muse_pi_pro"
CONFIG_ARCH_BOARD_CUSTOM_DIR_RELPATH=y
CONFIG_ARCH_BOARD_CUSTOM_NAME="muse_pi_pro"
CONFIG_ARCH_BOARD_K1_MUSE_PI_PRO=y
CONFIG_ALARM_ARCH=y
# The K1 timer implementation is a one-shot S-mode alarm.  Tickless
# scheduling lets it drive watchdog and work-queue deadlines directly.
CONFIG_SCHED_TICKLESS=y
CONFIG_ARCH_LOWPUTC=y
CONFIG_K1_EARLY_BOOT_LOG=y
CONFIG_K1_PRESERVE_BOOT_UART=y
CONFIG_K1_SBI_TIMEBASE_FREQUENCY=24000000
CONFIG_K1_UART_POLL_USEC=1000
CONFIG_BOARD_EARLY_INITIALIZE=y
CONFIG_BOARD_LATE_INITIALIZE=y
CONFIG_BOARDCTL_RESET=y
CONFIG_BUILTIN=y
CONFIG_DEV_CONSOLE=y
CONFIG_DEV_GPIO=y
CONFIG_DEBUG_FEATURES=y
CONFIG_DEBUG_SYMBOLS=y
CONFIG_FS_PROCFS=y
CONFIG_IDLETHREAD_STACKSIZE=4096
CONFIG_INIT_ENTRYPOINT="nsh_main"
CONFIG_INIT_STACKSIZE=8192
CONFIG_NSH_BUILTIN_APPS=y
CONFIG_NSH_FILEIOSIZE=512
CONFIG_NSH_READLINE=y
CONFIG_EXAMPLES_GPIO=y
CONFIG_EXAMPLES_GPIO_STACKSIZE=8192
CONFIG_ONESHOT=y
CONFIG_ONESHOT_COUNT=y
CONFIG_ONESHOT_FAST_DIVISION=y
CONFIG_RAM_START=0x11000000
CONFIG_RAM_SIZE=134217728
CONFIG_READLINE_CMD_HISTORY=y
CONFIG_SCHED_WAITPID=y
CONFIG_SYSTEM_NSH=y
CONFIG_SYSTEM_NSH_STACKSIZE=8192
CONFIG_USEC_PER_TICK=1000
```

## board/k1/muse_pi_pro/configs/spi3_loopback/defconfig
```kconfig
# K1 SPI3 40-pin MOSI-to-MISO loopback verification configuration.

#include "../nsh/defconfig"

CONFIG_DEFAULT_TASK_STACKSIZE=4096
CONFIG_NSH_MAXARGUMENTS=16
CONFIG_SPI=y
CONFIG_SPI_DRIVER=y
CONFIG_SYSTEM_SPITOOL=y
CONFIG_SPITOOL_STACKSIZE=4096
CONFIG_K1_SPI=y
CONFIG_K1_SPI3=y
CONFIG_K1_SPI_POLL_TIMEOUT_USEC=100000
CONFIG_SPITOOL_MINBUS=3
CONFIG_SPITOOL_MAXBUS=3
CONFIG_SPITOOL_DEFFREQ=800000
CONFIG_SPITOOL_DEFMODE=0
CONFIG_SPITOOL_DEFWIDTH=8
CONFIG_SPITOOL_DEFWORDS=4
```
