## middleware/velaros_ros2/Kconfig
```kconfig
#
# SPDX-License-Identifier: Apache-2.0
#

menu "VelaROS ROS 2"

config VELAROS_ROS2_CORE
	bool "ROS 2 Lyrical core interfaces"
	default n
	depends on LIBCXX
	---help---
		Build the locked rcutils, rosidl runtime, dynamic typesupport
		interface, and rmw interface libraries for openvela.

config VELAROS_ROS2_CORE_SMOKE
	bool "ROS 2 core interface smoke command"
	default y
	depends on VELAROS_ROS2_CORE
	---help---
		Add the velaros_core_smoke NSH command.  It validates the target
		allocator and the compiled rmw node-name rules without loading any
		host ROS libraries.

config VELAROS_ROS2_FASTRTPS_TYPESUPPORT
	bool "ROS 2 Fast DDS dynamic typesupport bridge"
	default n
	depends on VELAROS_ROS2_CORE && FASTDDS
	---help---
		Build the locked rcpputils and
		rosidl_dynamic_typesupport_fastrtps sources.  This is the first
		C++ layer between the ROS 2 type model and target-side Fast DDS.

config VELAROS_ROS2_RMW_DDS_COMMON
	bool "ROS 2 generated graph messages and rmw_dds_common"
	default n
	depends on VELAROS_ROS2_FASTRTPS_TYPESUPPORT
	---help---
		Build the host-generated rmw_dds_common message sources, their
		target-side Fast RTPS C++ type support, and the locked
		rmw_dds_common graph cache implementation.

config VELAROS_ROS2_RMW_DDS_COMMON_SMOKE
	bool "rmw_dds_common graph and generated typesupport smoke command"
	default y
	depends on VELAROS_ROS2_RMW_DDS_COMMON
	---help---
		Add the velaros_rmw_dds_smoke NSH command.  It validates the
		generated Fast RTPS type support and a graph-cache node update.

config VELAROS_ROS2_RMW_FASTRTPS_CPP
	bool "ROS 2 rmw_fastrtps_cpp implementation"
	default n
	depends on VELAROS_ROS2_RMW_DDS_COMMON
	---help---
		Build the locked rmw_fastrtps_shared_cpp and
		rmw_fastrtps_cpp implementations as target-side static libraries.
		Dynamic buffer plugins and Linux LTTng tracing stay disabled.

config VELAROS_ROS2_RMW_FASTRTPS_SMOKE
	bool "rmw_fastrtps context, node, and graph smoke command"
	default y
	depends on VELAROS_ROS2_RMW_FASTRTPS_CPP
	---help---
		Add the velaros_rmw_fastrtps_smoke NSH command.  It creates a
		real Fast DDS-backed RMW context and node, queries the ROS graph,
		and then verifies the complete destruction path.

config VELAROS_ROS2_RCL
	bool "ROS 2 rcl minimal lifecycle"
	default n
	depends on VELAROS_ROS2_RMW_FASTRTPS_CPP
	---help---
		Build the locked rcl 10.4.4 init, context, node, and guard
		condition lifecycle on top of rmw_fastrtps_cpp.  The first
		closure intentionally excludes YAML parameters, command-line
		remapping, rosout, and the type-description service.

config VELAROS_ROS2_RCL_SMOKE
	bool "rcl context and node lifecycle smoke command"
	default y
	depends on VELAROS_ROS2_RCL
	---help---
		Add the velaros_rcl_smoke NSH command.  It initializes rcl,
		creates and validates a Fast DDS-backed node, and verifies
		node, context, and init-options cleanup.

config VELAROS_ROS2_INTEROP
	bool "ROS 2 std_msgs/String talker and listener"
	default n
	depends on VELAROS_ROS2_RCL
	---help---
		Add target-side velaros_ros2_talker and velaros_ros2_listener
		commands using rcl, rmw_fastrtps_cpp, DDS, and the locked
		std_msgs/String generated type support.  These commands are the
		end-to-end interoperability boundary with a host ROS 2 node.

endmenu
```
